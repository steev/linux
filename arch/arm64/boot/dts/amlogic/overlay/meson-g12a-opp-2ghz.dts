/dts-v1/;
/plugin/;

/ {
	compatible = "radxa,zero", "amlogic,g12a";

	fragment@0 {
		target-path = "/opp-table";
		__overlay__ {
			opp-2004000000 {
				opp-hz = /bits/ 64 <2004000000>;
				opp-microvolt = <1022000>;
				turbo-mode;
			};
		};
	};
};
