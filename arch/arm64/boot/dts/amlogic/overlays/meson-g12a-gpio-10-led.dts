/dts-v1/;
/plugin/;
#include <dt-bindings/gpio/gpio.h>
#include <dt-bindings/gpio/meson-g12a-gpio.h>

/ {
	/delete-node/ leds;
};


/ {

	compatible = "radxa,zero", "amlogic,g12a";

	fragment@0 {
		target-path = "/leds";
		__overlay__ {
			led-green {
				label = "radxa-zero:green";
				gpios = <&gpio_ao GPIOAO_10 GPIO_ACTIVE_HIGH>;
				linux,default-trigger = "heartbeat";
				default-state = "on";
			};
		};
	};
};
