## Documentation/devicetree/bindings/dma/qcom_bam_dma.yaml
```yaml
# SPDX-License-Identifier: (GPL-2.0-only OR BSD-2-Clause)
%YAML 1.2
---
$id: http://devicetree.org/schemas/dma/qcom_bam_dma.yaml#
$schema: http://devicetree.org/meta-schemas/core.yaml#

title: QCOM BAM DMA controller binding

maintainers:
  - Bhupesh Sharma <bhupesh.sharma@linaro.org>

description: |
  This document defines the binding for the BAM DMA controller
  found on Qualcomm parts.

allOf:
  - $ref: "dma-controller.yaml#"

properties:
  compatible:
    enum:
      - qcom,bam-v1.4.0 # for MSM8974, APQ8074 and APQ8084
      - qcom,bam-v1.3.0 # for APQ8064, IPQ8064 and MSM8960
      - qcom,bam-v1.7.0 # for MSM8916

  reg:
    maxItems: 1

  clocks:
    maxItems: 1

  clock-names:
    const: bam_clk

  interrupts:
    minItems: 1
    maxItems: 31

  num-channels:
    maximum: 31
    description: |
      Indicates supported number of DMA channels in a remotely controlled bam.

  "#dma-cells":
    const: 1
    description: The single cell represents the channel index.

  interconnects:
    maxItems: 1
    description: |
      Interconnect path between bam and main memory.

  interconnect-names:
    const: memory

  qcom,ee:
    $ref: /schemas/types.yaml#/definitions/uint32
    description:
      Indicates the active Execution Environment identifier (0-7)
      used in the secure world.

  qcom,controlled-remotely:
    $ref: /schemas/types.yaml#/definitions/flag
    description:
      Indicates that the bam is controlled by remote proccessor i.e.
      execution environment.

  qcom,num-ees:
    $ref: /schemas/types.yaml#/definitions/uint32
    minimum: 0
    maximum: 31
    default: 2
    description:
      Indicates supported number of Execution Environments in a
      remotely controlled bam.

required:
  - compatible
  - reg
  - interrupts
  - "#dma-cells"
  - qcom,ee

additionalProperties: false

examples:
  - |
    #include <dt-bindings/clock/qcom,gcc-msm8974.h>
    dma-controller@f9984000 {
        compatible = "qcom,bam-v1.4.0";
        reg = <0xf9984000 0x15000>;
        interrupts = <0 94 0>;
        clocks = <&gcc GCC_BAM_DMA_AHB_CLK>;
        clock-names = "bam_clk";
        #dma-cells = <1>;
        qcom,ee = <0>;
    };
```

## Documentation/devicetree/bindings/interconnect/qcom,sdm845-cpu-bwmon.yaml
```yaml
# SPDX-License-Identifier: GPL-2.0-only OR BSD-2-Clause
%YAML 1.2
---
$id: http://devicetree.org/schemas/interconnect/qcom,sdm845-cpu-bwmon.yaml#
$schema: http://devicetree.org/meta-schemas/core.yaml#

title: Qualcomm Interconnect Bandwidth Monitor

maintainers:
  - Krzysztof Kozlowski <krzysztof.kozlowski@linaro.org>

description:
  Bandwidth Monitor measures current throughput on buses between various NoC
  fabrics and provides information when it crosses configured thresholds.

properties:
  compatible:
    enum:
      - qcom,sdm845-cpu-bwmon       # BWMON v4

  interconnects:
    maxItems: 2

  interconnect-names:
    items:
      - const: ddr
      - const: l3c

  interrupts:
    maxItems: 1

  operating-points-v2: true
  opp-table: true

  reg:
    # Currently described BWMON v4 and v5 use one register address space.
    # BWMON v2 uses two register spaces - not yet described.
    maxItems: 1

required:
  - compatible
  - interconnects
  - interconnect-names
  - interrupts
  - operating-points-v2
  - opp-table
  - reg

additionalProperties: false

examples:
  - |
    #include <dt-bindings/interconnect/qcom,osm-l3.h>
    #include <dt-bindings/interconnect/qcom,sdm845.h>
    #include <dt-bindings/interrupt-controller/arm-gic.h>

    pmu@1436400 {
        compatible = "qcom,sdm845-cpu-bwmon";
        reg = <0x01436400 0x600>;

        interrupts = <GIC_SPI 581 IRQ_TYPE_LEVEL_HIGH>;

        interconnects = <&gladiator_noc MASTER_APPSS_PROC 3 &mem_noc SLAVE_EBI1 3>,
                        <&osm_l3 MASTER_OSM_L3_APPS &osm_l3 SLAVE_OSM_L3>;
        interconnect-names = "ddr", "l3c";

        operating-points-v2 = <&cpu_bwmon_opp_table>;

        cpu_bwmon_opp_table: opp-table {
            compatible = "operating-points-v2";

            opp-0 {
                opp-peak-kBps = <800000 4800000>;
            };
            opp-1 {
                opp-peak-kBps = <1804000 9216000>;
            };
            opp-2 {
                opp-peak-kBps = <2188000 11980800>;
            };
            opp-3 {
                opp-peak-kBps = <3072000 15052800>;
            };
            opp-4 {
                opp-peak-kBps = <4068000 19353600>;
            };
            opp-5 {
                opp-peak-kBps = <5412000 20889600>;
            };
            opp-6 {
                opp-peak-kBps = <6220000 22425600>;
            };
            opp-7 {
                opp-peak-kBps = <7216000 25497600>;
            };
        };
    };
```

## Documentation/devicetree/bindings/media/qcom,sc7180-camss.yaml
```yaml
# SPDX-License-Identifier: (GPL-2.0 OR BSD-2-Clause)

%YAML 1.2
---
$id: http://devicetree.org/schemas/media/qcom,sc7180-camss.yaml#
$schema: http://devicetree.org/meta-schemas/core.yaml#

title: Qualcomm Camera SubSystem

maintainers:
  - Bryan O'Donoghue <bryan.odonoghue@linaro.org>

description:
  The CAMSS IP is a CSI decoder and ISP present on Qualcomm platforms

properties:
  compatible:
    const: qcom,sc7180-camss

  clocks:
    maxItems: 24

  clock-names:
    items:
      - const: camnoc_axi
      - const: cpas_ahb
      - const: csi0
      - const: csi1
      - const: csi2
      - const: csiphy0
      - const: csiphy0_timer
      - const: csiphy1
      - const: csiphy1_timer
      - const: csiphy2
      - const: csiphy2_timer
      - const: csiphy3
      - const: csiphy3_timer
      - const: gcc_camera_ahb
      - const: gcc_camera_axi
      - const: soc_ahb
      - const: vfe0_axi
      - const: vfe0
      - const: vfe0_cphy_rx
      - const: vfe1_axi
      - const: vfe1
      - const: vfe1_cphy_rx
      - const: vfe_lite
      - const: vfe_lite_cphy_rx

  interrupts:
    maxItems: 10

  interrupt-names:
    items:
      - const: csid0
      - const: csid1
      - const: csid2
      - const: csiphy0
      - const: csiphy1
      - const: csiphy2
      - const: csiphy3
      - const: vfe0
      - const: vfe1
      - const: vfe_lite

  iommus:
    maxItems: 3

  power-domains:
    items:
      - description: IFE0 GDSC - Image Front End, Global Distributed Switch Controller.
      - description: IFE1 GDSC - Image Front End, Global Distributed Switch Controller.
      - description: Titan GDSC - Titan ISP Block, Global Distributed Switch Controller.

  power-domain-names:
    items:
      - const: ife0
      - const: ife1
      - const: top

  ports:
    $ref: /schemas/graph.yaml#/properties/ports

    description:
      CSI input ports.

    properties:
      port@0:
        $ref: /schemas/graph.yaml#/$defs/port-base
        unevaluatedProperties: false
        description:
          Input port for receiving CSI data.

        properties:
          endpoint:
            $ref: video-interfaces.yaml#
            unevaluatedProperties: false

            properties:
              data-lanes:
                maxItems: 4

            required:
              - data-lanes

      port@1:
        $ref: /schemas/graph.yaml#/$defs/port-base
        unevaluatedProperties: false
        description:
          Input port for receiving CSI data.

        properties:
          endpoint:
            $ref: video-interfaces.yaml#
            unevaluatedProperties: false

            properties:
              data-lanes:
                maxItems: 4

            required:
              - data-lanes

      port@2:
        $ref: /schemas/graph.yaml#/$defs/port-base
        unevaluatedProperties: false
        description:
          Input port for receiving CSI data.

        properties:
          endpoint:
            $ref: video-interfaces.yaml#
            unevaluatedProperties: false

            properties:
              data-lanes:
                maxItems: 4

            required:
              - data-lanes

      port@3:
        $ref: /schemas/graph.yaml#/$defs/port-base
        unevaluatedProperties: false
        description:
          Input port for receiving CSI data.

        properties:
          endpoint:
            $ref: video-interfaces.yaml#
            unevaluatedProperties: false

            properties:
              data-lanes:
                maxItems: 4

            required:
              - data-lanes

  reg:
    maxItems: 10

  reg-names:
    items:
      - const: csid0
      - const: csid1
      - const: csid2
      - const: csiphy0
      - const: csiphy1
      - const: csiphy2
      - const: csiphy3
      - const: vfe0
      - const: vfe1
      - const: vfe_lite

  vdda-phy-supply:
    description:
      Phandle to a regulator supply to PHY core block.

  vdda-pll-supply:
    description:
      Phandle to 1.8V regulator supply to PHY refclk pll block.

required:
  - clock-names
  - clocks
  - compatible
  - interrupt-names
  - interrupts
  - iommus
  - power-domains
  - power-domain-names
  - reg
  - reg-names
  - vdda-phy-supply
  - vdda-pll-supply

additionalProperties: false

examples:
  - |
    #include <dt-bindings/interrupt-controller/arm-gic.h>
    #include <dt-bindings/clock/qcom,camcc-sc7180.h>
    #include <dt-bindings/clock/qcom,gcc-sc7180.h>
    #include <dt-bindings/power/qcom-rpmpd.h>

    soc {
      #address-cells = <2>;
      #size-cells = <2>;

      camss: camss@acb3000 {
        compatible = "qcom,sc7180-camss";

        reg = <0 0xacb3000 0 0x1000>,
              <0 0xacba000 0 0x1000>,
              <0 0xacc8000 0 0x1000>,
              <0 0xac65000 0 0x1000>,
              <0 0xac66000 0 0x1000>,
              <0 0xac67000 0 0x1000>,
              <0 0xac68000 0 0x1000>,
              <0 0xacaf000 0 0x4000>,
              <0 0xacb6000 0 0x4000>,
              <0 0xacc4000 0 0x4000>;

        reg-names = "csid0",
                    "csid1",
                    "csid2",
                    "csiphy0",
                    "csiphy1",
                    "csiphy2",
                    "csiphy3",
                    "vfe0",
                    "vfe1",
                    "vfe_lite";

        vdda-phy-supply = <&vreg_l1a_0p875>;
        vdda-pll-supply = <&vreg_l26a_1p2>;

        interrupts = <GIC_SPI 464 IRQ_TYPE_LEVEL_HIGH>,
                     <GIC_SPI 466 IRQ_TYPE_LEVEL_HIGH>,
                     <GIC_SPI 473 IRQ_TYPE_LEVEL_HIGH>,
                     <GIC_SPI 477 IRQ_TYPE_LEVEL_HIGH>,
                     <GIC_SPI 478 IRQ_TYPE_LEVEL_HIGH>,
                     <GIC_SPI 479 IRQ_TYPE_LEVEL_HIGH>,
                     <GIC_SPI 448 IRQ_TYPE_LEVEL_HIGH>,
                     <GIC_SPI 465 IRQ_TYPE_LEVEL_HIGH>,
                     <GIC_SPI 467 IRQ_TYPE_LEVEL_HIGH>,
                     <GIC_SPI 472 IRQ_TYPE_LEVEL_HIGH>;

        interrupt-names = "csid0",
                          "csid1",
                          "csid2",
                          "csiphy0",
                          "csiphy1",
                          "csiphy2",
                          "csiphy3",
                          "vfe0",
                          "vfe1",
                          "vfe_lite";

        power-domains = <&camcc IFE_0_GDSC>,
                        <&camcc IFE_1_GDSC>,
                        <&camcc TITAN_TOP_GDSC>;

        power-domain-names = "ife0",
                             "ife1",
                             "top";

        clocks = <&camcc CAM_CC_CAMNOC_AXI_CLK>,
                 <&camcc CAM_CC_CPAS_AHB_CLK>,
                 <&camcc CAM_CC_IFE_0_CSID_CLK>,
                 <&camcc CAM_CC_IFE_1_CSID_CLK>,
                 <&camcc CAM_CC_IFE_LITE_CSID_CLK>,
                 <&camcc CAM_CC_CSIPHY0_CLK>,
                 <&camcc CAM_CC_CSI0PHYTIMER_CLK>,
                 <&camcc CAM_CC_CSIPHY1_CLK>,
                 <&camcc CAM_CC_CSI1PHYTIMER_CLK>,
                 <&camcc CAM_CC_CSIPHY2_CLK>,
                 <&camcc CAM_CC_CSI2PHYTIMER_CLK>,
                 <&camcc CAM_CC_CSIPHY3_CLK>,
                 <&camcc CAM_CC_CSI3PHYTIMER_CLK>,
                 <&gcc GCC_CAMERA_AHB_CLK>,
                 <&gcc GCC_CAMERA_HF_AXI_CLK>,
                 <&camcc CAM_CC_SOC_AHB_CLK>,
                 <&camcc CAM_CC_IFE_0_AXI_CLK>,
                 <&camcc CAM_CC_IFE_0_CLK>,
                 <&camcc CAM_CC_IFE_0_CPHY_RX_CLK>,
                 <&camcc CAM_CC_IFE_1_AXI_CLK>,
                 <&camcc CAM_CC_IFE_1_CLK>,
                 <&camcc CAM_CC_IFE_1_CPHY_RX_CLK>,
                 <&camcc CAM_CC_IFE_LITE_CLK>,
                 <&camcc CAM_CC_IFE_LITE_CPHY_RX_CLK>;

        clock-names = "camnoc_axi",
                      "cpas_ahb",
                      "csi0",
                      "csi1",
                      "csi2",
                      "csiphy0",
                      "csiphy0_timer",
                      "csiphy1",
                      "csiphy1_timer",
                      "csiphy2",
                      "csiphy2_timer",
                      "csiphy3",
                      "csiphy3_timer",
                      "gcc_camera_ahb",
                      "gcc_camera_axi",
                      "soc_ahb",
                      "vfe0_axi",
                      "vfe0",
                      "vfe0_cphy_rx",
                      "vfe1_axi",
                      "vfe1",
                      "vfe1_cphy_rx",
                      "vfe_lite",
                      "vfe_lite_cphy_rx";

        iommus = <&apps_smmu 0x820 0x0>,
                 <&apps_smmu 0x840 0x0>,
                 <&apps_smmu 0x860 0x0>;

        ports {
          #address-cells = <1>;
          #size-cells = <0>;
        };
      };
    };
```
