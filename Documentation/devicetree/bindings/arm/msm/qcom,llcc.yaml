## Documentation/devicetree/bindings/arm/msm/qcom,llcc.yaml
```yaml
# SPDX-License-Identifier: (GPL-2.0-or-later OR BSD-2-Clause)
%YAML 1.2
---
$id: http://devicetree.org/schemas/arm/msm/qcom,llcc.yaml#
$schema: http://devicetree.org/meta-schemas/core.yaml#

title: Last Level Cache Controller

maintainers:
  - Sai Prakash Ranjan <quic_saipraka@quicinc.com>

description: |
  LLCC (Last Level Cache Controller) provides last level of cache memory in SoC,
  that can be shared by multiple clients. Clients here are different cores in the
  SoC, the idea is to minimize the local caches at the clients and migrate to
  common pool of memory. Cache memory is divided into partitions called slices
  which are assigned to clients. Clients can query the slice details, activate
  and deactivate them.

properties:
  compatible:
    enum:
      - qcom,sc7180-llcc
      - qcom,sc7280-llcc
      - qcom,sc8180x-llcc
      - qcom,sc8280xp-llcc
      - qcom,sdm845-llcc
      - qcom,sm6350-llcc
      - qcom,sm8150-llcc
      - qcom,sm8250-llcc
      - qcom,sm8350-llcc
      - qcom,sm8450-llcc

  reg:
    minItems: 2
    maxItems: 9

  interrupts:
    maxItems: 1

required:
  - compatible
  - reg

allOf:
  - if:
      properties:
        compatible:
          contains:
            enum:
              - qcom,sc7180-llcc
              - qcom,sm6350-llcc
    then:
      properties:
        reg:
          items:
            - description: LLCC0 base register region
            - description: LLCC broadcast base register region

  - if:
      properties:
        compatible:
          contains:
            enum:
              - qcom,sc7280-llcc
    then:
      properties:
        reg:
          items:
            - description: LLCC0 base register region
            - description: LLCC1 base register region
            - description: LLCC broadcast base register region

  - if:
      properties:
        compatible:
          contains:
            enum:
              - qcom,sc8180x-llcc
              - qcom,sc8280xp-llcc
    then:
      properties:
        reg:
          items:
            - description: LLCC0 base register region
            - description: LLCC1 base register region
            - description: LLCC2 base register region
            - description: LLCC3 base register region
            - description: LLCC4 base register region
            - description: LLCC5 base register region
            - description: LLCC6 base register region
            - description: LLCC7 base register region
            - description: LLCC broadcast base register region

  - if:
      properties:
        compatible:
          contains:
            enum:
              - qcom,sdm845-llcc
              - qcom,sm8150-llcc
              - qcom,sm8250-llcc
              - qcom,sm8350-llcc
              - qcom,sm8450-llcc
    then:
      properties:
        reg:
          items:
            - description: LLCC0 base register region
            - description: LLCC1 base register region
            - description: LLCC2 base register region
            - description: LLCC3 base register region
            - description: LLCC broadcast base register region

additionalProperties: false

examples:
  - |
    #include <dt-bindings/interrupt-controller/arm-gic.h>

    soc {
        #address-cells = <2>;
        #size-cells = <2>;

        system-cache-controller@1100000 {
          compatible = "qcom,sdm845-llcc";
          reg = <0 0x01100000 0 0x50000>, <0 0x01180000 0 0x50000>,
                <0 0x01200000 0 0x50000>, <0 0x01280000 0 0x50000>,
                <0 0x01300000 0 0x50000>;
          interrupts = <GIC_SPI 582 IRQ_TYPE_LEVEL_HIGH>;
        };
    };
```

## Documentation/devicetree/bindings/clock/qcom,gcc-sdm845.yaml
```yaml
# SPDX-License-Identifier: GPL-2.0-only
%YAML 1.2
---
$id: http://devicetree.org/schemas/clock/qcom,gcc-sdm845.yaml#
$schema: http://devicetree.org/meta-schemas/core.yaml#

title: Qualcomm Global Clock & Reset Controller Binding

maintainers:
  - Stephen Boyd <sboyd@kernel.org>
  - Taniya Das <tdas@codeaurora.org>

description: |
  Qualcomm global clock control module which supports the clocks, resets and
  power domains on SDM845

  See also:
  - dt-bindings/clock/qcom,gcc-sdm845.h

properties:
  compatible:
    const: qcom,gcc-sdm845

  clocks:
    items:
      - description: Board XO source
      - description: Board active XO source
      - description: Sleep clock source
      - description: PCIE 0 Pipe clock source (Optional clock)
      - description: PCIE 1 Pipe clock source (Optional clock)
    minItems: 3
    maxItems: 5

  clock-names:
    items:
      - const: bi_tcxo
      - const: bi_tcxo_ao
      - const: sleep_clk
      - const: pcie_0_pipe_clk # Optional clock
      - const: pcie_1_pipe_clk # Optional clock
    minItems: 3
    maxItems: 5

  '#clock-cells':
    const: 1

  '#reset-cells':
    const: 1

  '#power-domain-cells':
    const: 1

  reg:
    maxItems: 1

  protected-clocks:
    description:
      Protected clock specifier list as per common clock binding.

required:
  - compatible
  - reg
  - '#clock-cells'
  - '#reset-cells'
  - '#power-domain-cells'

additionalProperties: false

examples:
  # Example for GCC for MSM8960:
  - |
    #include <dt-bindings/clock/qcom,rpmh.h>
    clock-controller@100000 {
      compatible = "qcom,gcc-sdm845";
      reg = <0x100000 0x1f0000>;
      clocks = <&rpmhcc RPMH_CXO_CLK>,
               <&rpmhcc RPMH_CXO_CLK_A>,
               <&sleep_clk>;
      clock-names = "bi_tcxo", "bi_tcxo_ao", "sleep_clk";
      #clock-cells = <1>;
      #reset-cells = <1>;
      #power-domain-cells = <1>;
    };
...
```

## Documentation/devicetree/bindings/clock/qcom,sc8280xp-lpasscc.yaml
```yaml
# SPDX-License-Identifier: (GPL-2.0-only OR BSD-2-Clause)
%YAML 1.2
---
$id: http://devicetree.org/schemas/clock/qcom,sc8280xp-lpasscc.yaml#
$schema: http://devicetree.org/meta-schemas/core.yaml#

title: Qualcomm LPASS Core & Audio Clock Controller on SC8280XP

maintainers:
  - Srinivas Kandagatla <srinivas.kandagatla@linaro.org>

description: |
  Qualcomm LPASS core and audio clock control module provides the clocks,
  and reset on SC8280XP.

  See also::
    include/dt-bindings/clock/qcom,lpasscc-sc8280xp.h

properties:
  reg: true

  compatible:
    enum:
      - qcom,sc8280xp-lpassaudiocc
      - qcom,sc8280xp-lpasscc

  qcom,adsp-pil-mode:
    description:
      Indicates if the LPASS would be brought out of reset using
      peripheral loader.
    type: boolean

  '#clock-cells':
    const: 1

  '#reset-cells':
    const: 1

required:
  - compatible
  - reg
  - qcom,adsp-pil-mode
  - '#reset-cells'
  - '#clock-cells'

additionalProperties: false

examples:
  - |
    #include <dt-bindings/clock/qcom,lpasscc-sc8280xp.h>
    lpass_audiocc: clock-controller@32a9000 {
        compatible = "qcom,sc8280xp-lpassaudiocc";
        reg = <0x032a9000 0x1000>;
        qcom,adsp-pil-mode;
        #reset-cells = <1>;
        #clock-cells = <1>;
    };

  - |
    #include <dt-bindings/clock/qcom,lpasscc-sc8280xp.h>
    lpasscc: clock-controller@33e0000 {
        compatible = "qcom,sc8280xp-lpasscc";
        reg = <0x033e0000 0x12000>;
        qcom,adsp-pil-mode;
        #reset-cells = <1>;
        #clock-cells = <1>;
    };
...
```

## Documentation/devicetree/bindings/display/msm/dpu-sc8280xp.yaml
```yaml
# SPDX-License-Identifier: GPL-2.0-only or BSD-2-Clause
%YAML 1.2
---
$id: http://devicetree.org/schemas/display/msm/dpu-sc8280xp.yaml#
$schema: http://devicetree.org/meta-schemas/core.yaml#

title: Qualcomm Display Processing Unit for SC8280XP

maintainers:
  - Bjorn Andersson <bjorn.andersson@linaro.org>

description:
  Device tree bindings for MSM Mobile Display Subsystem (MDSS) that encapsulates
  sub-blocks like DPU display controller, DSI and DP interfaces etc. Device tree
  bindings of MDSS and DPU are mentioned for SC8280XP.

properties:
  compatible:
    const: qcom,sc8280xp-mdss

  reg:
    maxItems: 1

  reg-names:
    const: mdss

  power-domains:
    maxItems: 1

  clocks:
    items:
      - description: Display AHB clock from gcc
      - description: Display AHB clock from dispcc
      - description: Display core clock

  clock-names:
    items:
      - const: iface
      - const: ahb
      - const: core

  interrupts:
    maxItems: 1

  interrupt-controller: true

  "#address-cells": true

  "#size-cells": true

  "#interrupt-cells":
    const: 1

  iommus:
    items:
      - description: Phandle to apps_smmu node with SID mask for Hard-Fail port0

  ranges: true

  interconnects:
    minItems: 2
    maxItems: 2

  interconnect-names:
    items:
      - const: mdp0-mem
      - const: mdp1-mem

  resets:
    items:
      - description: MDSS_CORE reset

patternProperties:
  "^display-controller@[0-9a-f]+$":
    type: object
    description: Node containing the properties of DPU.

    properties:
      compatible:
        const: qcom,sc8280xp-dpu

      reg:
        items:
          - description: Address offset and size for mdp register set
          - description: Address offset and size for vbif register set

      reg-names:
        items:
          - const: mdp
          - const: vbif

      clocks:
        items:
          - description: Display hf axi clock
          - description: Display sf axi clock
          - description: Display ahb clock
          - description: Display lut clock
          - description: Display core clock
          - description: Display vsync clock

      clock-names:
        items:
          - const: bus
          - const: nrt_bus
          - const: iface
          - const: lut
          - const: core
          - const: vsync

      interrupts:
        maxItems: 1

      power-domains:
        maxItems: 1

      operating-points-v2: true

      ports:
        $ref: /schemas/graph.yaml#/properties/ports
        description: |
          Contains the list of output ports from DPU device. These ports
          connect to interfaces that are external to the DPU hardware,
          such as DSI, DP etc. Each output port contains an endpoint that
          describes how it is connected to an external interface.

        patternProperties:
          '^port@[0-8]$':
            $ref: /schemas/graph.yaml#/properties/port
            description: DPU interfaces

    required:
      - compatible
      - reg
      - reg-names
      - clocks
      - interrupts
      - power-domains
      - operating-points-v2
      - ports

required:
  - compatible
  - reg
  - reg-names
  - power-domains
  - clocks
  - interrupts
  - interrupt-controller
  - iommus
  - ranges

additionalProperties: false

examples:
  - |
    #include <dt-bindings/clock/qcom,dispcc-sc8280xp.h>
    #include <dt-bindings/clock/qcom,gcc-sc8280xp.h>
    #include <dt-bindings/interrupt-controller/arm-gic.h>
    #include <dt-bindings/interconnect/qcom,sc8280xp.h>
    #include <dt-bindings/power/qcom-rpmpd.h>

    display-subsystem@ae00000 {
      compatible = "qcom,sc8280xp-mdss";
      reg = <0x0ae00000 0x1000>;
      reg-names = "mdss";

      power-domains = <&dispcc0 MDSS_GDSC>;

      clocks = <&gcc GCC_DISP_AHB_CLK>,
               <&dispcc0 DISP_CC_MDSS_AHB_CLK>,
               <&dispcc0 DISP_CC_MDSS_MDP_CLK>;
      clock-names = "iface",
                    "ahb",
                    "core";

      assigned-clocks = <&dispcc0 DISP_CC_MDSS_MDP_CLK>;
      assigned-clock-rates = <460000000>;

      resets = <&dispcc0 DISP_CC_MDSS_CORE_BCR>;

      interrupts = <GIC_SPI 83 IRQ_TYPE_LEVEL_HIGH>;
      interrupt-controller;
      #interrupt-cells = <1>;

      interconnects = <&mmss_noc MASTER_MDP0 0 &mc_virt SLAVE_EBI1 0>,
                      <&mmss_noc MASTER_MDP1 0 &mc_virt SLAVE_EBI1 0>;
      interconnect-names = "mdp0-mem", "mdp1-mem";

      iommus = <&apps_smmu 0x1000 0x402>;

      #address-cells = <1>;
      #size-cells = <1>;
      ranges;

      display-controller@ae01000 {
        compatible = "qcom,sc8280xp-dpu";
        reg = <0x0ae01000 0x8f000>,
              <0x0aeb0000 0x2008>;
        reg-names = "mdp", "vbif";

        clocks = <&gcc GCC_DISP_HF_AXI_CLK>,
                 <&gcc GCC_DISP_SF_AXI_CLK>,
                 <&dispcc0 DISP_CC_MDSS_AHB_CLK>,
                 <&dispcc0 DISP_CC_MDSS_MDP_LUT_CLK>,
                 <&dispcc0 DISP_CC_MDSS_MDP_CLK>,
                 <&dispcc0 DISP_CC_MDSS_VSYNC_CLK>;
        clock-names = "bus",
                      "nrt_bus",
                      "iface",
                      "lut",
                      "core",
                      "vsync";

        assigned-clocks = <&dispcc0 DISP_CC_MDSS_MDP_CLK>,
                          <&dispcc0 DISP_CC_MDSS_VSYNC_CLK>;
        assigned-clock-rates = <460000000>,
                               <19200000>;

        operating-points-v2 = <&mdss0_mdp_opp_table>;
        power-domains = <&rpmhpd SC8280XP_MMCX>;

        interrupt-parent = <&mdss0>;
        interrupts = <0>;

        ports {
          #address-cells = <1>;
          #size-cells = <0>;

          port@0 {
            reg = <0>;
              endpoint {
                remote-endpoint = <&mdss0_dp0_in>;
              };
          };

          port@4 {
            reg = <4>;
            endpoint {
              remote-endpoint = <&mdss0_dp1_in>;
            };
          };

          port@5 {
            reg = <5>;
              endpoint {
                remote-endpoint = <&mdss0_dp3_in>;
              };
          };

          port@6 {
            reg = <6>;
              endpoint {
                remote-endpoint = <&mdss0_dp2_in>;
              };
          };
        };

        mdss0_mdp_opp_table: opp-table {
          compatible = "operating-points-v2";

          opp-200000000 {
            opp-hz = /bits/ 64 <200000000>;
            required-opps = <&rpmhpd_opp_low_svs>;
          };

          opp-300000000 {
            opp-hz = /bits/ 64 <300000000>;
            required-opps = <&rpmhpd_opp_svs>;
          };

          opp-345000000 {
            opp-hz = /bits/ 64 <345000000>;
            required-opps = <&rpmhpd_opp_svs_l1>;
          };

          opp-460000000 {
            opp-hz = /bits/ 64 <460000000>;
            required-opps = <&rpmhpd_opp_nom>;
          };
        };
      };
    };
...
```
